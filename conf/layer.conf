## conf/layer.conf
```bitbake
#
# Copyright (C) 2016-2017 Wind River Systems, Inc.
#

# We have a conf and classes directory, add to BBPATH
BBPATH =. "${LAYERDIR}:"

# We have a packages directory, add to BBFILES
BBFILES += "${LAYERDIR}/recipes-*/*/*.bb \
	${LAYERDIR}/recipes-*/*/*.bbappend \
	${LAYERDIR}/classes/*.bbclass"

BBFILE_COLLECTIONS += "wr-nxp-imx6"
BBFILE_PATTERN_wr-nxp-imx6 := "^${LAYERDIR}/"
BBFILE_PRIORITY_wr-nxp-imx6 = "7"

PREFERRED_PROVIDER_virtual/kernel ?= "linux-yocto"

# This should only be incremented on significant changes that will
# cause compatibility issues with other layers
LAYERVERSION_wr-nxp-imx6 = "1"

# We have a pre-populated downloads directory, add to PREMIRRORS
PREMIRRORS_append = " \
     .*://.*/.* file://${LAYERDIR}/downloads/ \n \
	 git://.*/.* git://${LAYERDIR}/git/MIRRORNAME;protocol=file \n \
"
```

## conf/machine/fsl-imx6.conf
```bitbake
#@TYPE: Machine
#@NAME: fsl-imx6
#@DESCRIPTION: fsl-imx6

DEFAULTTUNE ?= "armv7athf-neon"

require conf/machine/include/tune-cortexa9.inc

MACHINE_FEATURES = "ext3 pci usbgadget usbhost vfat alsa touchscreen"

KERNEL_IMAGETYPE = "zImage"

SERIAL_CONSOLE = "115200 ttymxc0"
```

## conf/machine/nxp-imx6.conf
```bitbake
#@TYPE: Machine
#@NAME: nxp-imx6
#@DESCRIPTION: nxp-imx6

UBOOT_CONFIG ??= "sd"
UBOOT_CONFIG[sd] = "mx7dsabresd_config,sdcard" 

DEFAULTTUNE ?= "armv7athf-neon"

require conf/machine/include/tune-cortexa9.inc

MACHINE_FEATURES = "ext3 pci usbgadget usbhost vfat alsa touchscreen"

KERNEL_IMAGETYPE = "zImage"
KERNEL_DEVICETREE = "imx6q-sabresd.dtb \
                     imx6sx-sdb.dtb"

SERIAL_CONSOLE = "115200 ttymxc0"


MACHINE_EXTRA_RRECOMMENDS = " kernel-modules kernel-devicetree linux-firmware-iwlwifi-6000g2a-6 linux-firmware-iwlwifi-6000g2b-6"
IMAGE_FSTYPES += "tar.bz2"
IMAGE_INSTALL_append = " kernel-devicetree kernel-image-zimage"

IMAGE_BOOT_FILES ?= "imx6q-sabresd.dtb boot.scr"

EXTRA_IMAGEDEPENDS_append_nxp-imx6 += "${@bb.utils.contains('INCOMPATIBLE_LICENSE', 'GPLv3', '', 'oprofile', d)} u-boot-imx-uenv"
```

## scripts/lib/wic/canned-wks/sdimage.wks
```
# short-description: Create a nxp-imx6 disk image (SD card)
# long-description: Create a partitioned disk image for NXP imx6
# The first partition is NULL, reserved for uboot.
# The second partition is to accommodate kernel, dtb and rootfs.

part / --ondisk mmcblk --no-table --size 4M
part / --source rootfs --ondisk mmcblk --fstype=ext4 --label root --align 4
```
